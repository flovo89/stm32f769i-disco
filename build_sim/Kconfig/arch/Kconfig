## build_sim/Kconfig/arch/Kconfig
```kconfig
# Load Zephyr Arch Kconfig descriptions.
osource "/home/flo/projects/stm32f769i-disco/zephyrproject/zephyr/arch/rx/Kconfig"
osource "/home/flo/projects/stm32f769i-disco/zephyrproject/zephyr/arch/x86/Kconfig"
osource "/home/flo/projects/stm32f769i-disco/zephyrproject/zephyr/arch/xtensa/Kconfig"
osource "/home/flo/projects/stm32f769i-disco/zephyrproject/zephyr/arch/sparc/Kconfig"
osource "/home/flo/projects/stm32f769i-disco/zephyrproject/zephyr/arch/riscv/Kconfig"
osource "/home/flo/projects/stm32f769i-disco/zephyrproject/zephyr/arch/posix/Kconfig"
osource "/home/flo/projects/stm32f769i-disco/zephyrproject/zephyr/arch/openrisc/Kconfig"
osource "/home/flo/projects/stm32f769i-disco/zephyrproject/zephyr/arch/mips/Kconfig"
osource "/home/flo/projects/stm32f769i-disco/zephyrproject/zephyr/arch/arm64/Kconfig"
osource "/home/flo/projects/stm32f769i-disco/zephyrproject/zephyr/arch/arm/Kconfig"
osource "/home/flo/projects/stm32f769i-disco/zephyrproject/zephyr/arch/arc/Kconfig"
```

## build_sim/Kconfig/boards/Kconfig
```kconfig
# Load Zephyr board Kconfig descriptions.
osource "/home/flo/projects/stm32f769i-disco/zephyrproject/zephyr/boards/st/stm32f769i_disco/Kconfig"
```

## build_sim/Kconfig/boards/Kconfig.defconfig
```kconfig
# Load Zephyr board defconfig descriptions.
osource "/home/flo/projects/stm32f769i-disco/zephyrproject/zephyr/boards/st/stm32f769i_disco/Kconfig.defconfig"
```
